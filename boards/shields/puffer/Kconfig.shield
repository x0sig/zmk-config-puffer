## boards/shields/puffer/Kconfig.shield
```kconfig
# Copyright (c) 2020 Pete Johanson
# SPDX-License-Identifier: MIT

config SHIELD_PUFFER_LEFT
    def_bool $(shields_list_contains,puffer_left)

config SHIELD_PUFFER_RIGHT
    def_bool $(shields_list_contains,puffer_right)
```
